
// Basic Example to demonstrate getting JSON formatted data, parsing and displaying on a TFT screen
// This example puts the api url request and JSON parsing into a function that populates global varialbles with weather data.
// The program also show how to use the built in button functions on the TTGO-T Display ESP32 board
// This code is provided just for educational interest and fun.
//
//How to get the JSON parsing code
  // Step 1:  get a sample of the expected json file using your brower
  // example from openweathermap.org:  api.openweathermap.org/data/2.5/weather?zip=73071,us&units=imperial&APPID=xxxgetyourownapicode:)
  // cutpaste into arduinojason helper:  https://arduinojson.org/v6/assistant/
  //   {"coord":{"lon":-97.41,"lat":35.23},"weather":[{"id":803,"main":"Clouds","description":"broken clouds","icon":"04d"}],"base":"stations","main":{"temp":47.28,"pressure":1023,"humidity":34,"temp_min":44.6,"temp_max":50},
  //   "visibility":16093,"wind":{"speed":8.05,"deg":170},"clouds":{"all":75},"dt":1575317431,"sys":{"type":1,"id":5187,"country":"US","sunrise":1575292847,"sunset":1575328657},"timezone":-21600,"id":0,"name":"Norman","cod":200}
  // Step 2:  paste in the capacity - const size_t capacity = JSON_ARRAY_SIZE..... (note:  this size seem borderline small, so I padded it - see code below)
  // Step 3:  paste in the parsing lines generated by the helper
// https://arduinojson.org/v6/example/http-client/

#include <ArduinoJson.h>
#include <SPI.h>

//************************************* TTGO-T-Display Libraries *************************************************************
#include <TFT_eSPI.h>
#include <SPI.h>
#include <Wire.h>
#include <Button2.h>

//custom fonts - must be located in the library under  "TFT_eSPI\Fonts\Custom" folder
//custom font bitmap data must be located in the TFT_eSPI/Fonts/Custom folder
//#include statement for each custom font must also be added to the "User_Custom_Fonts.h" file in the "TFT_eSPI\User_Setups" folder.
//Not all these fonts are used, but I left them in the code for ease of experimenting
#define GFXFF 1  //this must be set to 1 to load the font files defined in User_Custom_Fonts.h
//#define FF18 &FreeSans12pt7b
//#define CF_CG16 &Crafty_Girls_Regular_16
#define CF_CG20 &Crafty_Girls_Regular_20
#define CF_CG24 &Crafty_Girls_Regular_24

TFT_eSPI tft = TFT_eSPI(135, 240); // Invoke custom library
#define BUTTON_1 35
#define BUTTON_2 0
Button2 btn1(BUTTON_1);
Button2 btn2(BUTTON_2);
int caseselector = 0;
bool buttonpressed = false;

/****************************Button Functions****************************************************/
void button_init()
{
  btn1.setLongClickHandler([](Button2 &b) {
    //longclick time is set in the libray file button2.h  #define LONGCLICK_MS    1250
    int r = digitalRead(TFT_BL);
    tft.fillScreen(TFT_BLACK);
    tft.setTextColor(TFT_GREEN, TFT_BLACK);
    tft.setTextDatum(MC_DATUM);
    tft.drawString("Press again to", tft.width() / 2, tft.height() / 2);
    tft.drawString("wake up", tft.width() / 2, 30 + tft.height() / 2);
    delay(6000);
    digitalWrite(TFT_BL, !r);

    tft.writecommand(TFT_DISPOFF);
    tft.writecommand(TFT_SLPIN);
    esp_sleep_enable_ext1_wakeup(GPIO_SEL_35, ESP_EXT1_WAKEUP_ALL_LOW);
    esp_deep_sleep_start();
  });

  btn1.setPressedHandler([](Button2 &b) {
    Serial.println("btn1 pressed");
    buttonpressed = true;
    caseselector < 3 ? caseselector++ : caseselector = 0;  //increments to another zipcode
    Serial.println(caseselector);
  });

  btn2.setPressedHandler([](Button2 &b) {
    Serial.println("btn2 pressed");
    buttonpressed = true;  //refreshes the weather data without changing the zipcode
  });
}

void button_loop()
{
  btn1.loop();
  btn2.loop();
}

//*******************************************************************************************************************************

// WiFi and AP
#ifdef ESP8266
#include <ESP8266WiFi.h>
#include <WiFiClient.h>
#include <ESP8266WebServer.h>
#include <ESP8266mDNS.h>
ESP8266WebServer server(80);
#else
#include <WiFi.h>
#include <WiFiClient.h>
#include <WebServer.h>
#include <ESPmDNS.h>
WebServer server(80);
#endif

#include <time.h>
#include <WiFiManager.h> //modified to compile for ESP32 in Arduino IDE

unsigned long previousTime = 0;         // for time update
unsigned long interval = 5 * 60 * 1000; // 5 min interval to update weather

// Weather Variables
char *servername = "api.openweathermap.org"; // remote server we will connect to
String ZipCode = "73104,us";                 //OKC
//String ZipCode = "94304,us"; //Palo Alto
//String ZipCode = "94541,us"; //Hayward
String APIKEY = "yourapicodehere";

char loc[80];   //to store char *name
char weat[80]; //to store value from char *weather_0_description
float main_temp;
int main_humidity;

WiFiClient client;
const int httpPort = 80;

void getWeather();

void setup()
{
  // Initialize Serial port
  Serial.begin(115200);
  while (!Serial)
    continue;

  //************************************* Initialize Buttons ******************************************
  button_init();
  //************************************* Initialize the Screen **************************************************
  tft.init();
  tft.setRotation(3);                                   // set rotation 1 - 0 deg rotation, 2 - 90 deg, 3 - 180 deg, 4 - 270 deg
  tft.setTextColor(TFT_WHITE, TFT_RED);   // Set font color
  tft.fillScreen(TFT_RED);                           // Clear screen
  tft.setFreeFont(CF_CG20);                       // Select the font:  for print and printf or with GFXFF
  //***************************************************************************************************************

  //display note on screen to set up wifi credentials
  tft.drawCentreString("Set Up Wifi @", tft.width() / 2, 30, GFXFF);
  tft.drawCentreString("AutoConnectAP", tft.width() / 2, 55, GFXFF);

  // Initialize wifi
  //WiFi.mode(WIFI_STA);
  WiFiManager wifiManager;
  wifiManager.autoConnect("AutoConnectAP");

  // Wait for connection
  while (WiFi.status() != WL_CONNECTED)
  {
    delay(500);
    Serial.print(".");
  }

  tft.fillScreen(TFT_RED);

  getWeather();

  //*****************Display Weather Data to the TFT Screen*******************************************************************************************************************
  Serial.println(loc);
  Serial.println(main_temp);
  Serial.println(main_humidity);
  Serial.println(weat);
  tft.setFreeFont(CF_CG24);   
  tft.fillScreen(TFT_BLUE);
  tft.setTextColor(TFT_YELLOW, TFT_BLUE);
  tft.setCursor(10, 40);

  //display the city name, temperature, humidity and description
  tft.printf("%s\n %.1fF %3i%%\n %s ", loc, main_temp, main_humidity, weat);

}

void loop()
{
  button_loop();
  int currentTime = millis();
  if (currentTime - previousTime > interval)
  {
    // periodically refresh the weather data
    previousTime = currentTime;
    buttonpressed = true;
  }

  if (buttonpressed == true)
  {
    buttonpressed = false;
    switch (caseselector)
    {

    case 0:
    {
      Serial.print("case ");
      Serial.println(caseselector);
      ZipCode = "73104,us"; //OKC OK
      getWeather();
      
      //*****************Display Weather Data to the TFT Screen*******************************************************************************************************************
      Serial.println(loc);
      Serial.println(main_temp);
      Serial.println(main_humidity);
      Serial.println(weat);

      tft.fillScreen(TFT_BLUE);
      tft.setTextColor(TFT_YELLOW, TFT_BLUE);
      tft.setCursor(10, 40);

      //display the city name, temperature, humidity and description
      tft.printf("%s\n %.1fF %3i%%\n %s ", loc, main_temp, main_humidity, weat);
      break;
    }

    case 1:
    {
      Serial.print("case ");
      Serial.println(caseselector);
      ZipCode = "73071,us"; //Norman OK
      getWeather();

      //*****************Display Weather Data to the TFT Screen*******************************************************************************************************************
      Serial.println(loc);
      Serial.println(main_temp);
      Serial.println(main_humidity);
      Serial.println(weat);

      tft.fillScreen(TFT_BLUE);
      tft.setTextColor(TFT_YELLOW, TFT_BLUE);
      tft.setCursor(10, 40);

      //display the city name, temperature, humidity and description
      tft.printf("%s\n %.1fF %3i%%\n %s ", loc, main_temp, main_humidity, weat);
      break;
    }

    case 2:
    {
      Serial.print("case ");
      Serial.println(caseselector);
      ZipCode = "94541,us"; //Hayward CA
      getWeather();

      //*****************Display Weather Data to the TFT Screen*******************************************************************************************************************
      Serial.println(loc);
      Serial.println(main_temp);
      Serial.println(main_humidity);
      Serial.println(weat);

      tft.fillScreen(TFT_BLUE);
      tft.setTextColor(TFT_YELLOW, TFT_BLUE);
      tft.setCursor(10, 40);

      //display the city name, temperature, humidity and description
      tft.printf("%s\n %.1fF %3i%%\n %s ", loc, main_temp, main_humidity, weat);
      break;
    }

    case 3:
    {
      Serial.print("case ");
      Serial.println(caseselector);
      ZipCode = "94304,us"; //Palo Alto, CA
      getWeather();

      //*****************Display Weather Data to the TFT Screen*******************************************************************************************************************
      Serial.println(loc);
      Serial.println(main_temp);
      Serial.println(main_humidity);
      Serial.println(weat);

      tft.fillScreen(TFT_BLUE);
      tft.setTextColor(TFT_YELLOW, TFT_BLUE);
      tft.setCursor(10, 40);

      //display the city name, temperature, humidity and description
      tft.printf("%s\n %.1fF %3i%%\n %s ", loc, main_temp, main_humidity, weat);
      break;
    }

    default:
    {
      Serial.print("case ");
      Serial.println(caseselector);
      break;
    }
    }
  }
}

void getWeather()
{
  //*************************************  Get Weather Function ***********************************************************

  /*
This function uses these following global variables

    char *servername = "api.openweathermap.org"; // remote server we will connect to
    String ZipCode = "94304,us"; //Palo Alto
    String APIKEY = "yourapicodehere";
    const int httpPort = 80;

    char loc[] // to store char *name;  use strcpy(loc, name) to copy name to loc
    char weat[] // to store char *weather_0_description;
    float main_temp;
    int main_humidity;
*/

  // Connect to HTTP server

  if (!client.connect(servername, httpPort))
  {
    return;
  }

  Serial.println(F("Connected!"));

  String url = "/data/2.5/weather?zip=" + ZipCode + "&units=imperial&APPID=" + APIKEY;

  // Send HTTP request
  Serial.println("Requesting URL: " + url);
  // This will send the request to the server
  client.print(String("GET ") + url + " HTTP/1.1\r\n");
  client.print("Host: api.openweathermap.org\r\n");
  client.print("Connection: close\r\n\r\n");

  delay(10);

  if (client.println() == 0)
  {
    Serial.println(F("Failed to send request"));
    return;
  }

  // Check HTTP status
  char status[32] = {0};
  client.readBytesUntil('\r', status, sizeof(status));
  // It should be "HTTP/1.0 200 OK" or "HTTP/1.1 200 OK"
  if (strcmp(status + 9, "200 OK") != 0)
  {
    Serial.print(F("Unexpected response: "));
    Serial.println(status);
    return;
  }

  // Skip HTTP headers
  char endOfHeaders[] = "\r\n\r\n";
  if (!client.find(endOfHeaders))
  {
    Serial.println(F("Invalid response"));
    return;
  }

  // Allocate the JSON document as doc
  // Use arduinojson.org/v6/assistant to compute the capacity.  The pad came from the recommended "Additional bytes for strings duplication" size in the assistant.
  int PAD = 1333;
  //****************************************************from https://arduinojson.org/v6/assistant/ **********************************************************************
  const size_t capacity = JSON_ARRAY_SIZE(1) + JSON_OBJECT_SIZE(1) + 2 * JSON_OBJECT_SIZE(2) + JSON_OBJECT_SIZE(4) + 2 * JSON_OBJECT_SIZE(5) + JSON_OBJECT_SIZE(13) + 270 + PAD;
  DynamicJsonDocument doc(capacity);
  //deserializeJson(doc, client);  // no error checking - never seems to fail or crash with propper PAD size, but also is a little risky
  //*********************************************************************************************************************************************************************

  // Instead of directly using the deserializeJson line, this modifies Parse JSON object as doc from client with error checking 
  DeserializationError error = deserializeJson(doc, client);
  if (error)
  {
    Serial.print(F("deserializeJson() failed: "));
    Serial.println(error.c_str());
    //return;  //commented this to turn it into a warning instead of a hard fail
  }

  //**************************************************** from https://arduinojson.org/v6/assistant/ **********************************************************************
  // Extract values
  float coord_lon = doc["coord"]["lon"]; // -97.41
  float coord_lat = doc["coord"]["lat"]; // 35.23

  JsonObject weather_0 = doc["weather"][0];
  int weather_0_id = weather_0["id"];                           // 800
  const char *weather_0_main = weather_0["main"];               // "Clear"
  const char *weather_0_description = weather_0["description"]; // "clear sky"
  strcpy(weat, weather_0_description);                                 // "clear sky"
  const char *weather_0_icon = weather_0["icon"];               // "01d"
  const char *base = doc["base"];                               // "stations"

  JsonObject main = doc["main"];
  //float main_temp = main["temp"];         // 46.17
  main_temp = main["temp"];             // 46.17
  int main_pressure = main["pressure"]; // 1025
  //int main_humidity = main["humidity"];   // 36
  main_humidity = main["humidity"];       // 36
  float main_temp_min = main["temp_min"]; // 44.6
  int main_temp_max = main["temp_max"];   // 48

  int visibility = doc["visibility"]; // 16093

  float wind_speed = doc["wind"]["speed"]; // 5.82
  int wind_deg = doc["wind"]["deg"];       // 210

  int clouds_all = doc["clouds"]["all"]; // 1

  long dt = doc["dt"]; // 1575312640

  JsonObject sys = doc["sys"];
  int sys_type = sys["type"];               // 1
  int sys_id = sys["id"];                   // 4424
  const char *sys_country = sys["country"]; // "US"
  long sys_sunrise = sys["sunrise"];        // 1575292847
  long sys_sunset = sys["sunset"];          // 1575328657

  int timezone = doc["timezone"]; // -21600
  int id = doc["id"];             // 0
  const char *name = doc["name"]; // "Norman"
  strcpy(loc, name);
  int cod = doc["cod"]; // 200

  // Disconnect
  client.stop();
  //*********************************************************************************************************************************************************************
}
